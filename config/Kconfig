## config/Kconfig
```kconfig
#
# Copyright (c) 2022 The ZMK Contributors
# SPDX-License-Identifier: MIT
#

config BOARD_CORNE_LEFT
    bool

config BOARD_CORNE_RIGHT
    bool
CONFIG_BOARD_ENABLE_DCDC=y
CONFIG_BOARD_ENABLE_DCDC_HV=y
```
